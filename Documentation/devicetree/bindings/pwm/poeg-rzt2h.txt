## Documentation/devicetree/bindings/pwm/poeg-rzt2h.txt
```
* Renesas RZ/T2H Port Output Enable for GPT (POEG)

Required Properties:
- compatible: Must be "renesas,poeg-rzt2h"

- reg: Base address and length of the registers block for the POEG.
- interrupts: IRQ line for POEG.
- clocks:	References to all the clocks specified in the clock-names
		property as specified in
		Documentation/devicetree/bindings/clock/clock-bindings.txt.
- clock-names: Name of clock.
- power-domains: Must contain a reference to the PM domain, if available.
- pinctrl-0: phandle, referring to a default pin configuration node.
- pinctrl-names: Set to "default".

Example: R9A07G044 (RZ/G2L) Port Output Enable for GPT (POEG)

	poeg0_a: poega@90019000 {
		compatible = "renesas,poeg-r9a09g077";
		reg = <0 0x90019000 0 0x400>;
		interrupts = <GIC_SPI 467 IRQ_TYPE_LEVEL_HIGH>;
		clocks = <&cpg CPG_CORE R9A09G077_PCLKH>;
		power-domains = <&cpg>;
		llpp,disable-by-DSMIF-error;
		status = "disabled";
	};
```

## Documentation/devicetree/bindings/rtc/rtc-rzt2h.txt
```
Real Time Clock on-chip Renesas RZ/T2H

Required properties:
- compatible: Must be set "renesas,rzt2h-rtc"
- reg: physical base address of the controller and length of memory mapped
  region.
- interrupt: IRQ line for the RTC.
- clocks: Clock source for RTC.

Optional properties:
- interrupt-name: name of interrupt line.
- clocks: Name of clock source.

Example:

rtc: rtc@81009000 {
	compatible = "renesas,rzt2h-rtc";
	reg = <0 0x81009000 0 0x70>;
	interrupts =	<GIC_SPI 495 IRQ_TYPE_EDGE_RISING>,
			<GIC_SPI 496 IRQ_TYPE_EDGE_RISING>,
			<GIC_SPI 497 IRQ_TYPE_EDGE_RISING>;
	interrupt-names = "alarm", "carry", "periodic";
	status = "disabled";
};
```

## drivers/char/ly_char/Kconfig
```kconfig
# SPDX-License-Identifier: GPL-2.0-only
#
# Linyang devices
#

config LY_CHAR
	tristate "linyang char"
	depends on ARCH_RENESAS
	help
	   linyang char

if LY_CHAR

config LY_EARLY_WATCHDOG
	tristate "linyang early watchdog"
	depends on ARCH_RENESAS
        help
           linyang early watchdog

config LY_ST75161
	tristate "linyang st75161"
	depends on ARCH_RENESAS
        help
           linyang st75161

config LY_POWER
	tristate "linyang power"
	depends on ARCH_RENESAS
        help
           linyang power

config LY_WATCHDOG
	tristate "linyang watchdog"
	depends on ARCH_RENESAS
        help
           linyang watchdog

endif # if LY_CHAR
```
